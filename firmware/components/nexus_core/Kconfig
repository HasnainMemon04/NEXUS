## firmware/components/nexus_core/Kconfig
```kconfig
menu "NEXUS"

    config NX_WIFI_SSID
        string "Cluster Wi-Fi name (SSID)"
        default "NEXUS-OS"

    config NX_WIFI_PASSWORD
        string "Cluster Wi-Fi password (WPA2, at least 8 characters)"
        default "nexus-os-lab"
        help
            Change this for your own demo with: idf.py menuconfig -> NEXUS.
            It is a lab password for an offline network, not a secret.

    config NX_WIFI_CHANNEL
        int "Wi-Fi channel of the master's access point"
        range 1 13
        default 6

endmenu
```

## firmware/master/sdkconfig.defaults
```kconfig
# Control Center and the N16R8 master memory profile.
CONFIG_HTTPD_WS_SUPPORT=y
CONFIG_HTTPD_MAX_REQ_HDR_LEN=1024
CONFIG_LWIP_MAX_SOCKETS=16
CONFIG_ESP_MAIN_TASK_STACK_SIZE=6144
CONFIG_ESPTOOLPY_FLASHSIZE_16MB=y
CONFIG_PARTITION_TABLE_CUSTOM=y
CONFIG_PARTITION_TABLE_CUSTOM_FILENAME="../partitions.csv"
CONFIG_SPIRAM=y
CONFIG_SPIRAM_MODE_OCT=y
CONFIG_ESP_DEFAULT_CPU_FREQ_MHZ_240=y
```

## firmware/tests/device/sdkconfig.defaults
```kconfig
CONFIG_ESPTOOLPY_FLASHSIZE_4MB=y
CONFIG_ESP_MAIN_TASK_STACK_SIZE=4096
CONFIG_ESP_DEFAULT_CPU_FREQ_MHZ_240=y
```

## firmware/worker/sdkconfig.defaults.esp32s3
```kconfig
# Optional ESP32-S3-N16R8 worker build.
CONFIG_ESPTOOLPY_FLASHSIZE_16MB=y
CONFIG_SPIRAM=y
CONFIG_SPIRAM_MODE_OCT=y
# CONFIG_FREERTOS_UNICORE is not set
# CONFIG_ESP_WIFI_SOFTAP_SUPPORT is not set
```
